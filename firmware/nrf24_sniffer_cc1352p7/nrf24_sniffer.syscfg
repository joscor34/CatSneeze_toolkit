/**
 * nrf24_sniffer.syscfg — TI SysConfig para CC1352P7
 *
 * Configura los recursos de hardware necesarios:
 *   - RF (radio core propietario 2.4 GHz)
 *   - UART2 (comunicación con el host Python)
 *   - Power (DC/DC habilitado para LP_CC1352P7)
 *
 * RTOS: FreeRTOS (compilado como fuente, compatible con GCC)
 */

// ── Módulo RF ─────────────────────────────────────────────────────────────────
const RF = scripting.addModule("/ti/drivers/RF");
// Sin configuración adicional: el radio se inicia desde nrf24_sniffer.c
// usando RF_open() con el RF_Mode generado por smartrf_settings.c

// ── Módulo UART2 (backchannel XDS110 UART @ 115200 baud, DIO12/DIO13) ─────────
const UART2 = scripting.addModule("/ti/drivers/UART2");
const uart0 = UART2.addInstance();
uart0.$name      = "CONFIG_UART2_0";
uart0.$hardware  = system.deviceData.board.components.XDS110UART;

// ── Power (DC/DC habilitado en LP_CC1352P7-1) ─────────────────────────────────
const Power = scripting.addModule("/ti/drivers/Power");
Power.enablePolicy = true;
// DC/DC ya está habilitado por el perfil LP_CC1352P7-1 del board hardware
